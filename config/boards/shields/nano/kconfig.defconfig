## config/boards/shields/nano/kconfig.defconfig
```kconfig
# Copyright (c) 2020 Pete Johanson, Richard Jones
# SPDX-License-Identifier: MIT

if SHIELD_NANO

config ZMK_KEYBOARD_NAME
	default "zmk-dima2"
```
